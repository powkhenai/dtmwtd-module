## boards/shields/dtmwtd/Kconfig.defconfig
```kconfig
if SHIELD_DTMWTD_LEFT

config ZMK_KEYBOARD_NAME
    default "Dont Tell Me"

config ZMK_SPLIT_ROLE_CENTRAL
    default y

config ZMK_SPLIT_BLE_CENTRAL_BATTERY_LEVEL_FETCHING
    default y

endif

if SHIELD_DTMWTD_LEFT || SHIELD_DTMWTD_RIGHT

config ZMK_SPLIT
    default y

endif
```

## boards/shields/dtmwtd/Kconfig.shield
```kconfig
config SHIELD_DTMWTD_LEFT
    def_bool $(shields_list_contains,dtmwtd_left)

config SHIELD_DTMWTD_RIGHT
    def_bool $(shields_list_contains,dtmwtd_right)
```
